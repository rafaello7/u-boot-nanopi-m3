## board/s5p6818/Kconfig
```kconfig
choice
	prompt "Board select"

config TARGET_S5P6818_DRONE
	bool "S5P6818_DRONE"
	help
	  Support for s5p6818 drone platform.

config TARGET_ARTIK710_RAPTOR
	bool "ARTIK710_RAPTOR"
	help
	  Support for artik710_raptor platform.

endchoice

config SYS_VENDOR
	default "s5p6818"

config SYS_CONFIG_NAME
	string "Board header file"
	help
	  This option should contain the base name of board header file.
	  The header file include/configs/<CONFIG_SYS_CONFIG_NAME>.h
	  should be included from include/config.h.

source "board/s5p6818/drone/Kconfig"
source "board/s5p6818/artik710_raptor/Kconfig"
```

## configs/nanopim3_defconfig
```kconfig
CONFIG_ARM=y
CONFIG_SYS_CONFIG_NAME="s5p6818_nanopim3"
CONFIG_ARCH_NEXELL=y
CONFIG_ARCH_S5P6818=y
CONFIG_SYS_MALLOC_F=y
CONFIG_DEFAULT_DEVICE_TREE="s5p6818-nanopim3"
CONFIG_TARGET_S5P6818_NANOPIM3=y
CONFIG_FIT=y
# CONFIG_CMD_IMI is not set
# CONFIG_CMD_IMLS is not set
# CONFIG_CMD_FLASH is not set
# CONFIG_CMD_FPGA is not set
# CONFIG_CMD_SETEXPR is not set
# CONFIG_CMD_NET is not set
# CONFIG_CMD_NFS is not set
CONFIG_CMD_FDISK=y
CONFIG_CMD_EXT4_IMG_WRITE=y
CONFIG_CMD_SD_RECOVERY=y
CONFIG_OF_CONTROL=y
CONFIG_OF_EMBED=y
CONFIG_VIDEO_NX=y
CONFIG_VIDEO_NX_HDMI=y
```
